;UNIVERSIDAD DEL VALLE DE GUATEMALA
;IE2023: PROGRAMACIсN DE MICROCONTROLADORES
;Lab2.asm
;AUTOR: Jose AndrИs VelАsquez GarcМa  
;PROYECTO: Contador binario de 4 bits
;HARDWARE: ATMEGA328P
;CREADO: 06/02/2024
;зLTIMA MODIFICACIсN: 06/02/2024 10:54
;********************************

.INCLUDE "M328PDEF.INC"
.CSEG
.ORG 0X00


;STACK POINTER 
;********************************
LDI R16, LOW(RAMEND)
OUT SPL, R16
LDI R16, HIGH(RAMEND)
OUT SPH, R16

SETUP:
;CLK SELECT: 1MHz 
	LDI R16, (1<<CLKPCE)
	STS CLKPR, R16
	LDI R16, 0b00000100
	STS CLKPR, R16
	
	;PC5; SALIDAS

	LDI R16, 0B0011_1100
	STS DDRC, R16
	
	CALL Init_T0
	
	;GUARDA EL CONTADOR, HECHO POR LA SUBRUTINA INCOUNTER
	.DEF COUNTER=R18

	

LOOP:
	;COMPARAR BANDERA 
	IN R16, TIFR0
	CPI R16, (1<<TOV0)
	BRNE LOOP

	CALL INCCOUNTER
	CALL OUTPUTDISPLAY
	
	;RREINICIAR EL TIMER
	LDI R16, 157
	OUT TCNT0, R16
	SBI TIFR0, TOV0 ;REINICIAR BANDERA

	RJMP LOOP

Init_T0:
;10MS
	LDI R16, 0
	OUT TCCR0A, R16

	LDI R16, (1 << CS02)|(1<< CS00)
	OUT TCCR0B, R16

	LDI R16, 157
	OUT TCNT0, R16

	LDI R16, 0
	RET

;SUBRUTINAS

INCCOUNTER:
;IR SUBIENDO EL CONRADOR
	MOV R17, COUNTER
	INC R17
	CBR R17, 0b1111_0000 
	MOV COUNTER, R17
	RET	
	
OUTPUTDISPLAY:
;SACAR EL CONTADOR AL PUERTOC
	MOV R17, COUNTER
	LSL R17
	LSL R17 
	OUT PORTC, R17
	RET




